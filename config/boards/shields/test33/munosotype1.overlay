/*
 * Copyright (c) 2020 The ZMK Contributors
 *
 * SPDX-License-Identifier: MIT
 */

/ {
    chosen {
        zmk,kscan = &kscan0;
    };

    kscan0: kscan {
        compatible = "zmk,kscan-gpio-matrix";
        row-gpios = <&gpio0 43 (GPIO_PULL_UP | GPIO_ACTIVE_LOW)>,
                    <&gpio0 24 (GPIO_PULL_UP | GPIO_ACTIVE_LOW)>,
                    <&gpio0 32 (GPIO_PULL_UP | GPIO_ACTIVE_LOW)>;

        col-gpios = <&gpio0 47 GPIO_ACTIVE_LOW>,
                    <&gpio0 2 GPIO_ACTIVE_LOW>,
                    <&gpio0 29 GPIO_ACTIVE_LOW>;

        debounce-press-ms = <5>;
        debounce-release-ms = <5>;
    };
};
