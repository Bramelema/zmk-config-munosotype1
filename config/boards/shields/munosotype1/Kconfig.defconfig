## config/boards/shields/munosotype1/Kconfig.defconfig
```kconfig
# Copyright (c) 2020 The ZMK Contributors
# SPDX-License-Identifier: MIT

if SHIELD_munosotype1

config ZMK_KEYBOARD_NAME
    default "munosotype1"

endif
```

## config/boards/shields/munosotype1/Kconfig.shield
```kconfig
# Copyright (c) 2020 The ZMK Contributors
# SPDX-License-Identifier: MIT

config SHIELD_munosotype1
    def_bool $(shields_list_contains,munosotype1)
```
